## drivers/input/sensors/Kconfig
```kconfig
#
# Sensor driver configuration
#

config SENSORS_AK09911
        tristate "AK09911 compass support"
        default n
        depends on I2C
        help
          If you say yes here you get support for Asahi Kasei's
          orientation sensor AK09911.

config SENSORS_KXTJ2_FE170CG
        tristate "KIONIX_ACCEL KXTJ2-1009 g-sensor"
        default n
        depends on I2C
        help
          If you say yes here you get support for Kionix's
          digital 3-axis accelerometer KXTJ2-1009.

config SENSORS_TF103_KXTJ2
        tristate "KIONIX_ACCEL KXTJ2-1009 g-sensor"
        default n
        depends on I2C
        help
          If you say yes here you get support for Kionix digital 3-axis
          accelerometer


config SENSORS_TF103_AK09911
        tristate "AK09911 compass support"
        default n
        depends on I2C
        help
          If you say yes here you get support for Asahi Kasei's
          orientation sensor AK09911.
```

## drivers/power/ASUS_BATTERY/FE170CG/Kconfig
```kconfig
#
#  Battery driver configuration
#

if FE170CG

menuconfig FE170CG_BATTERY
	bool "ME372CL Battery support"
        default y
	help
	  Say Y here. This option doesn't affect the kernel.
	  If unsure, say Y.

config FE170CG_BATTERY_SMB345
	tristate "SMB345 battery charger driver"
	depends on I2C
        default y
	help
	  Say Y to enable support for the SMB345 switching mode based charger
	  and sysfs. The driver supports controlling charger-enable and
	  current limiting capabilities.

config FE170CG_PMIC_SNB5072C1
	bool "PMIC SNB5072C1"
	depends on FE170CG_BATTERY_SMB345
	help
	  Say Y to enable PMIC SNB5072C1 function

config UPI_BATTERY
	bool "UPI gauge driver"
	depends on I2C
        default y
	help
	  Say Y to enable it

config SN280X_CHARGER
	bool "charger driver"
	depends on I2C
	help
	  Say Y to enable it

config EC_POWER
	bool "asus ec power information driver"
	depends on EEPROM_PADSTATION
	help
	  Say Y to enable it

config FE170CG_BATTERY_BQ27520
	tristate "BQ27520 battery driver"
	depends on I2C
	help
	  Say Y here to enable support for batteries with BQ27520(I2C) chips.

endif
```
